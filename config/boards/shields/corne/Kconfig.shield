## config/boards/shields/corne/Kconfig.shield
```kconfig
# Copyright (c) 2020 The ZMK Contributors
# SPDX-License-Identifier: MIT

config SHIELD_ENKI42_LEFT
	def_bool $(shields_list_contains,enki42_left)

config SHIELD_ENKI42_RIGHT
	def_bool $(shields_list_contains,enki42_right)

config SHIELD_ENKI42_DONGLE_PRO_MICRO
	def_bool $(shields_list_contains,enki42_dongle_pro_micro)

config SHIELD_ENKI42_DONGLE_XIAO
	def_bool $(shields_list_contains,enki42_dongle_xiao)
```

## config/west.yml
```yaml
manifest:
  defaults:
    revision: main
  remotes:
    - name: zmkfirmware
      url-base: https://github.com/zmkfirmware
    - name: urob
      url-base: https://github.com/urob
    - name: carrefinho                            
      url-base: https://github.com/carrefinho     
  projects:
    - name: zmk
      remote: zmkfirmware
      revision: main
      import: app/west.yml
    - name: zmk-unicode
      remote: urob
      revision: main
    - name: prospector-zmk-module
      remote: carrefinho
      revision: feat/new-status-screens
  self:
    path: config
```
